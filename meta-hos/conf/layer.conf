## meta-hos/conf/layer.conf
```bitbake
# We have a conf and classes directory, add to BBPATH
BBPATH .= ":${LAYERDIR}"

# We have recipes-* directories, add to BBFILES
BBFILES += "${LAYERDIR}/recipes-*/*/*.bb \
            ${LAYERDIR}/recipes-*/*/*.bbappend"

BBFILE_COLLECTIONS += "meta-hos"
BBFILE_PATTERN_meta-hos = "^${LAYERDIR}/"
BBFILE_PRIORITY_meta-hos = "6"

LAYERDEPENDS_meta-hos = "core"
LAYERSERIES_COMPAT_meta-hos = "thud"
```
